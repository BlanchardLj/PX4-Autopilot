## src/drivers/lights/Kconfig
```kconfig
menu "Lights"
    menuconfig COMMON_LIGHT
        bool "Common Light's"
        default y
        select DRIVERS_LIGHTS_RGBLED
        select DRIVERS_LIGHTS_RGBLED_NCP5623C
        select DRIVERS_LIGHTS_RGBLED_WS2812
        ---help---
            Enable default set of light drivers
    rsource "*/Kconfig"
endmenu
```

## src/drivers/lights/rgbled_ws2812/Kconfig
```kconfig
menuconfig DRIVERS_LIGHTS_RGBLED_WS2812
	bool "rgbled_ws2812"
	default y
	---help---
		Enable support for rgbled_ws2812
```
